## atf-20250711/plat/mediatek/mt7987/Config.in
```kconfig
# SPDX-License-Identifier: BSD-3-Clause
#
# Copyright (c) 2026 Yuzhii0718 <admin@yuzhii0718.eu.org>
#
# MT7987 platform-specific configurations
#

if _PLAT_MT7987

config _ENABLE_I2P5G_PHY
	bool "Enable internal 2.5G PHY support"
	default y
	select _SUPPORTS_I2P5G_PHY

choice
	prompt "Internal 2.5G PHY mode"
	depends on _SUPPORTS_I2P5G_PHY
	default _I2P5G_PHY_1P2L

	config _I2P5G_PHY_1P2L
		bool "1 port 2 lane"

	config _I2P5G_PHY_2P1L
		bool "2 port 1 lane"

endchoice

config I2P5G_PHY_MODE
	int
	default 0 if _I2P5G_PHY_1P2L
	default 1 if _I2P5G_PHY_2P1L

endif # _PLAT_MT7987
```
